## conf/bblayers.conf
```bitbake
# POKY_BBLAYERS_CONF_VERSION is increased each time build/conf/bblayers.conf
# changes incompatibly
POKY_BBLAYERS_CONF_VERSION = "2"

BBPATH = "${TOPDIR}"
BSPDIR = "${TOPDIR}/.."
BBFILES ?= ""

BBLAYERS ?= " \
  ${BSPDIR}/sources/poky/meta \
  ${BSPDIR}/sources/poky/meta-poky \
  ${BSPDIR}/sources/poky/meta-yocto-bsp \
  \
  ${BSPDIR}/sources/meta-raspberrypi \
  \
  ${BSPDIR}/sources/meta-openembedded/meta-oe \
  ${BSPDIR}/sources/meta-openembedded/meta-multimedia \
  ${BSPDIR}/sources/meta-openembedded/meta-networking \
  ${BSPDIR}/sources/meta-openembedded/meta-python \
  \
  ${BSPDIR}/sources/meta-orca \
  "
```

## sources/meta-orca/conf/layer.conf
```bitbake
# We have a conf and classes directory, add to BBPATH
BBPATH .= ":${LAYERDIR}"
BBFILE_PATTERN_orca = "^${LAYERDIR}/"
BBFILE_COLLECTIONS += "orca"

# We have recipes-* directories, add to BBFILES
BBFILES += "${LAYERDIR}/recipes-*/*/*.bb \
            ${LAYERDIR}/recipes-*/*/*.bbappend"

MACHINE_EXTRA_RDEPENDS += "kernel-module-helloworld"
MACHINE_EXTRA_RDEPENDS += "kernel-module-paramsWithTiming"
MACHINE_EXTRA_RDEPENDS += "kernel-module-import-and-export"
MACHINE_EXTRA_RDEPENDS += "kernel-module-kernelsocketfun"

DISTRO_EXTRA_RRECOMMENDS += "openssh binksf"

LAYERSERIES_COMPAT_orca = "kirkstone"
```
